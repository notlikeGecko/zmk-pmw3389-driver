## dts/bindings/pixart,pmw3389.yml
```yaml
description: |
  Sensor driver for the pixart PMW3389 mouse sensor 

compatible: "pixart,pmw3389"

include: spi-device.yaml

properties:
  irq-gpios:
    type: phandle-array
    required: true
  cpi:
    type: int
    default: 1500
    description: "CPI value (Range: 50 - 16000, Step: 50)"
  swap-xy:
    type: boolean
  invert-x:
    type: boolean
  invert-y:
    type: boolean
```
